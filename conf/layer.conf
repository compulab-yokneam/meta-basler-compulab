## conf/layer.conf
```bitbake
# We have a conf and classes directory, add to BBPATH
BBPATH .= ":${LAYERDIR}"

# We have recipes-* directories, add to BBFILES
BBFILES += "${LAYERDIR}/recipes-*/*/*.bb \
            ${LAYERDIR}/recipes-*/*/*.bbappend"

BBFILE_COLLECTIONS += "meta-basler-compulab"
BBFILE_PATTERN_meta-basler-compulab = "^${LAYERDIR}/"
BBFILE_PRIORITY_meta-basler-compulab = "50"

LAYERSERIES_COMPAT_meta-basler-compulab = "walnascar scarthgap"

LICENSE_PATH += "${LAYERDIR}/licenses"

BBMASK += "meta-basler-imx8/recipes-bsp/u-boot/u-boot-imx_2022.04.bbappend "
BBMASK += "meta-basler-imx8/recipes-imx8mp/isp-imx/isp-imx_4.2.2.20.0.bbappend "
BBMASK += "meta-basler-imx8/recipes-imx8mp/kernel-modules/kernel-module-isp-vvcam_4.2.2.20.0.bbappend "
BBMASK += "meta-basler-imx8/recipes-imx8mp/dart-bcon-mipi/basler-camera_4.2.2.20.0.bbappend "
BBMASK += "meta-basler-imx8/recipes-kernel/linux/linux-imx-headers_5.15.bbappend "
BBMASK += "meta-basler-imx8/recipes-kernel/linux/linux-imx_5.15.bbappend "

ACCEPT_BASLER_EULA = "1"
IMAGE_INSTALL:append = " packagegroup-dart-bcon-mipi "
BB_CHECK_SSL_CERTS = "0"
```
